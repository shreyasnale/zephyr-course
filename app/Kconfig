## app/Kconfig
```kconfig
# SPDX-License-Identifier: Apache-2.0

menuconfig LED_SUBSYSTEM
    bool "LED Subsystem"
    default y

if LED_SUBSYSTEM

choice LED_BLINK_SLEEP_TIME
    prompt "LED blink sleep time"
    default LED_BLINK_1S

config LED_BLINK_100MS
    bool "100ms (fast)"

config LED_BLINK_1S
    bool "1s (medium)"

config LED_BLINK_2S
    bool "2s (slow)"

endchoice

menuconfig LED_ADVANCED_SETTINGS
    bool "Advanced LED settings"

if LED_ADVANCED_SETTINGS

config LED_BRIGHTNESS
    int "LED brightness (0-100)"
    range 0 100
    default 100

config LED_FADE_DURATION
    int "LED fade duration (ms)"
    default 500

menu "Expert settings"

config LED_DEBUG
    bool "Enable LED debugging"

config LED_CUSTOM_BLINK
    bool "Custom blink pattern"

endmenu

endif

endif

source "Kconfig.zephyr"
```

## boards/custom/nucleo_f401re_custom/board.yml
```yaml
board:
  name: nucleo_f401re_custom
  full_name: Nucleo F401RE Custom
  vendor: custom
  socs:
    - name: stm32f401xe
```

## boards/custom/nucleo_f401re_scratch/Kconfig.nucleo_f401re_scratch
```kconfig
# SPDX-License-Identifier: Apache-2.0

config BOARD_NUCLEO_F401RE_SCRATCH
    select SOC_STM32F401XE
```

## boards/custom/nucleo_f401re_scratch/board.yml
```yaml
board:
  name: nucleo_f401re_scratch
  full_name: Nucleo F401RE Scratch
  vendor: custom
  socs:
    - name: stm32f401xe
```
